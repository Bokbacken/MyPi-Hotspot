## main/Kconfig.projbuild
```kconfig
menu "MyPi-Hotspot"

    menu "Wi-Fi"
        config MYPI_WIFI_SSID
            string "Wi-Fi SSID"
            default "TOFTA"
            help
                SSID of the access point the device joins in station mode.

        config MYPI_WIFI_PASSWORD
            string "Wi-Fi password"
            default "bokbacken"
            help
                WPA/WPA2/WPA3 password. Leave empty for an open network.

        config MYPI_WIFI_BACKOFF_MAX_S
            int "Max reconnect back-off (seconds)"
            range 2 600
            default 60
            help
                Reconnect delay doubles after each failed attempt (1, 2, 4 ... s)
                up to this limit.

        config MYPI_HOSTNAME
            string "Hostname (DHCP and mDNS)"
            default "mypi-hotspot"
            help
                The device answers to <hostname>.local via mDNS.

        config MYPI_AP_SSID
            string "Default access point SSID"
            default "MyPi-Hotspot"
            help
                Used at boot when no saved AP profile is marked "start at boot".
                The default AP uses 192.168.4.1/24 with NAT to the uplink.

        config MYPI_AP_PASSWORD
            string "Default access point password"
            default "mypi1234"
            help
                WPA2 password (8-63 characters). Leave empty for an open AP.

        config MYPI_AP_MAX_CONN
            int "Max stations on the access point"
            range 1 10
            default 10
            help
                ESP-Hosted limits the soft-AP to 10 stations (MAX_CONN_NO on the host).

        config MYPI_AP_AUTOSTART
            bool "Start the default AP at boot"
            default y
            help
                If disabled, the AP only starts at boot when an AP profile has
                "start at boot" set, or when started from the web UI.

    endmenu

    menu "Ethernet"
        config MYPI_ETH_ENABLE
            bool "Enable on-board Ethernet (IP101 RMII PHY)"
            default y

        config MYPI_ETH_PHY_ADDR
            int "PHY address (-1 = auto detect)"
            range -1 31
            default -1
            depends on MYPI_ETH_ENABLE

        config MYPI_ETH_PHY_RST_GPIO
            int "PHY reset GPIO (-1 = none)"
            range -1 54
            default 51
            depends on MYPI_ETH_ENABLE
    endmenu

    menu "Display"
        config MYPI_LCD_SPI_CLOCK_MHZ
            int "LCD SPI clock (MHz)"
            range 1 80
            default 40
            help
                SPI pixel clock for the ST7789. 40 MHz is a stable working value
                with short (10-20 cm) jumper wires and gives ~30 ms per full-screen
                refresh. Lower to 20 MHz if you see noise, shifted pixels or wrong
                colors. The ST7789 write spec is ~62 MHz; above that is out of spec.

        config MYPI_LCD_INVERT_COLOR
            bool "Invert colors (INVON)"
            default y
            help
                The Waveshare 2" ST7789 module needs color inversion for correct colors.
                Disable if black and white appear swapped.

        config MYPI_LCD_BGR_ORDER
            bool "Use BGR element order"
            default n
            help
                Enable if red and blue appear swapped.

        config MYPI_LCD_ROTATE_180
            bool "Rotate screen and touch 180 degrees by default"
            default n
            help
                Default for the 180-degree rotation (display mirrored in X and Y,
                touch coordinates flipped). Can be changed at runtime in the web UI;
                the web UI setting is saved in NVS and overrides this default.

    endmenu

    menu "Touch"
        config MYPI_TOUCH_I2C_KHZ
            int "Touch I2C clock (kHz)"
            range 10 400
            default 400
            help
                I2C clock for the CST816D on TP_SDA/TP_SCL. 400 kHz (Fast-mode) is the
                rated maximum of both the CST816D and the on-board ES8311 codec that
                shares the bus. Lower to 100 kHz if the touch error counter on the
                web status page starts climbing.

        config MYPI_TOUCH_USE_INT
            bool "Use TP_INT interrupt (read only when the controller signals)"
            default y
            help
                The CST816 goes to sleep when idle and then does not answer on I2C.
                With this enabled the firmware waits for a TP_INT falling edge
                instead of polling a sleeping chip. Disable to poll continuously.

        config MYPI_TOUCH_VERBOSE_I2C_LOGS
            bool "Show I2C driver error logs"
            default n
            help
                The I2C driver prints one error per failed transaction, which can
                flood the console. When disabled, the touch driver prints its own
                rate-limited summary instead.
    endmenu

    menu "Diagnostics"
        config MYPI_DEBUG_MODE_DEFAULT
            bool "Debug mode on by default"
            default n
            help
                Debug mode can be switched on/off at runtime on the web status page
                (stored in NVS, survives reboot). This option only sets the value
                used before anything has been stored.
                With debug mode on: DEBUG-level logs from the app (touch DOWN/MOVE,
                init steps, pin levels), a heartbeat every 5 s, and at boot the
                wiring check, panel ID read, I2C bus scan and color test pattern.

        config MYPI_HEARTBEAT_INTERVAL_S
            int "Serial heartbeat interval (seconds, normal mode)"
            range 1 3600
            default 60
            help
                In debug mode the heartbeat is printed every 5 s instead.

        config MYPI_LOG_BUFFER_SIZE
            int "In-RAM log ring buffer size (bytes)"
            range 2048 262144
            default 32768
            help
                Log lines are mirrored into this buffer (allocated in PSRAM) and
                exposed on the web UI and /api/log.
    endmenu

    menu "Camera"
        config MYPI_CAMERA_ENABLE
            bool "MIPI-CSI camera (OV5647 / P5V04A SUNNY)"
            default y
            depends on IDF_TARGET_ESP32P4
            help
                Camera on the ESP32-P4-NANO CSI connector via espressif/esp_video (V4L2, CSI +
                ISP) with the OV5647 driver from esp_cam_sensor (auto-detected over SCCB).
                Adds the LCD "Camera" page and the web "Camera" tab. Photos are saved as
                JPEG in /store/photos (FAT 'storage' partition). Without a camera the
                firmware runs normally and both pages show "Camera not detected".

        config MYPI_CAMERA_SCCB_KHZ
            int "SCCB (I2C) clock (kHz)"
            range 50 400
            default 100
            help
                The camera control bus is the board I2C bus (GPIO7/8) shared with the touch
                controller; the camera driver adds its device to the touch driver's bus.

        config MYPI_CAMERA_RESET_GPIO
            int "Camera reset GPIO (-1 = not connected)"
            range -1 54
            default -1

        config MYPI_CAMERA_PWDN_GPIO
            int "Camera power-down GPIO (-1 = not connected)"
            range -1 54
            default -1

        config MYPI_CAMERA_HFLIP
            bool "Mirror the image horizontally"
            default n

        config MYPI_CAMERA_VFLIP
            bool "Flip the image vertically"
            default n

        config MYPI_CAMERA_JPEG_QUALITY
            int "JPEG quality of saved photos"
            range 10 100
            default 95

        config MYPI_CAMERA_PREVIEW_QUALITY
            int "JPEG quality of the web preview"
            range 10 100
            default 95
            help
                Lower = smaller frames and a faster web preview.

        config MYPI_CAMERA_MAX_PHOTOS
            int "Photos kept in /store/photos"
            range 1 500
            default 20
            help
                The oldest photo is deleted when a new one would exceed this count. The
                storage partition is about 3.9 MB and shared with the log store.

        config MYPI_CAMERA_STORAGE_RESERVE_KB
            int "Storage space kept free for logs (KB)"
            range 0 2048
            default 512
            help
                A capture fails with "Storage full" instead of using this space.

        config MYPI_CAMERA_IDLE_STOP_S
            int "Stop the camera stream after (seconds without use)"
            range 2 600
            default 10
            help
                The stream (sensor, CSI, ISP, frame buffers) only runs while a preview is
                shown; it stops this long after the last frame was used.
    endmenu

endmenu
```
